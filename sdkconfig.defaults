## sdkconfig.defaults
```kconfig
CONFIG_HTTPD_MAX_REQ_HDR_LEN=1024
CONFIG_SPIFFS_OBJ_NAME_LEN=64
CONFIG_FATFS_LONG_FILENAME=y
CONFIG_FATFS_LFN_HEAP=y
CONFIG_ESPTOOLPY_FLASHSIZE_4MB=y
CONFIG_PARTITION_TABLE_CUSTOM=y
CONFIG_PARTITION_TABLE_CUSTOM_FILENAME="partitions_example.csv"
CONFIG_PARTITION_TABLE_FILENAME="partitions_example.csv"
CONFIG_ESP32_HUB75_USE_GFX=n
CONFIG_IDF_TARGET="esp32s3"
CONFIG_IDF_TARGET_ESP32S3=y
```

## src/Kconfig.projbuild
```kconfig
menu "Lumen"
    menu "Website"
        config WEB_MOUNT_POINT
            string "Website mount point in VFS"
            default "/www"
            help
                Specify the mount point in VFS.

    endmenu

    menu "Networking"
        menu "Wi-Fi"
            config WIFI_SSID
                string "SoftAP SSID"
                default "lumen"
                help
                    SSID (network name) to setup the softAP with.

            config WIFI_PASSWORD
                string "SoftAP Password"
                default "lumenaries"
                help
                    Wi-Fi password (WPA or WPA2) to use for the softAP.

            config MAX_STA_CONNECTION
                int "Maxmium STA Connections"
                default 4
                help
                    Max number of STA connections to AP.
        endmenu

        menu "mDNS"
            config MDNS_HOSTNAME
                string "mDNS Hostname"
                default "lumen"
                help
                    mDNS hostname to allow users users to navigate to the UI.

        endmenu
    endmenu
endmenu
```
